## src/ps2_ble_kbd/Kconfig.projbuild
```kconfig
menu "PS/2 Keyboard"

    config PS2_CLK_GPIO
        int "PS/2 Clock GPIO number"
        default 6
        range 0 7
        help
            GPIO connected to the PS/2 keyboard CLK line.
            Must be GPIO 0–7 (LP-capable) for deep sleep wakeup.

    config PS2_DATA_GPIO
        int "PS/2 Data GPIO number"
        default 7
        help
            GPIO connected to the PS/2 keyboard DATA line.

    config DEEP_SLEEP_TIMEOUT_SEC
        int "Deep sleep inactivity timeout (seconds)"
        default 300
        range 30 3600
        help
            Seconds of keyboard inactivity before entering deep sleep.
            The ESP32-C6 draws ~5 µA in deep sleep and wakes on the
            next keypress (PS/2 CLK falling edge).

endmenu
```

## src/ps2_ble_kbd/sdkconfig.defaults
```kconfig
# Bluetooth: NimBLE only (ESP32-C6 is BLE-only, no Classic BT)
CONFIG_BT_ENABLED=y
CONFIG_BT_NIMBLE_ENABLED=y
CONFIG_BT_CLASSIC_ENABLED=n

# Persist bonding keys across reboots (required for HID reconnection)
CONFIG_BT_NIMBLE_NVS_PERSIST=y

# Secure Connections pairing (ECDH-based, BT 4.2+)
CONFIG_BT_NIMBLE_SM_SC=1

# GAP device name visible during Bluetooth scan
CONFIG_BT_NIMBLE_SVC_GAP_DEVICE_NAME="ESP32-C6 Keyboard"

# Single-host keyboard — one connection is sufficient
CONFIG_BT_NIMBLE_MAX_CONNECTIONS=1

# Power management: automatic light sleep when idle
CONFIG_PM_ENABLE=y
CONFIG_FREERTOS_USE_TICKLESS_IDLE=y
CONFIG_PM_POWER_DOWN_CPU_IN_LIGHT_SLEEP=y
```
